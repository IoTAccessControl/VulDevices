## CMakeLists.txt
```
# SPDX-License-Identifier: Apache-2.0

cmake_minimum_required(VERSION 3.13.1)

include($ENV{ZEPHYR_BASE}/cmake/app/boilerplate.cmake NO_POLICY_SCOPE)

project(IoTPatch)

set(IOTPATCH_DIR ${CMAKE_CURRENT_SOURCE_DIR}/../../PatchCore/)

message("======================================")
message(${IOTPATCH_DIR})
message("======================================")

file(GLOB iotpatchsrc
        "${IOTPATCH_DIR}/hotpatch/include/*.h"
        "${IOTPATCH_DIR}/hotpatch/src/*.c"
        "${IOTPATCH_DIR}/app/*.h"
        "${IOTPATCH_DIR}/app/*.c"
        "${IOTPATCH_DIR}/libebpf/include/*.h"
        "${IOTPATCH_DIR}/libebpf/src/*.c")

list(REMOVE_ITEM iotpatchsrc "${IOTPATCH_DIR}/libebpf/src/main.c")

include($ENV{ZEPHYR_BASE}/samples/net/common/common.cmake)

include_directories(
        "${IOTPATCH_DIR}/"
        "${IOTPATCH_DIR}/hotpatch"
        "${IOTPATCH_DIR}/app"
        "${IOTPATCH_DIR}/libebpf"
        # "./src/mqtt"
        "./src/coap"
        "$ENV{ZEPHYR_BASE}/subsys/net/ip"
)

# add_definitions(-DSYS_CORTEX_M4 -DZEPHYR_OS)
# add_definitions(-DSYS_CORTEX_M4 -DZEPHYR_OS -DDEV_STM32F429)
add_definitions(-DSYS_CORTEX_M4 -DZEPHYR_OS -DDEV_NRF52840 -DDEV_COAP)
# add_definitions(-DSYS_CORTEX_M4 -DZEPHYR_OS -DDEV_STM32F429 -DDEV_MQTT)
# add_definitions(-DSYS_CORTEX_M4 -DZEPHYR_OS -DDEV_NRF52840)


# target_sources(app PRIVATE src/main_empty.c src/coap/coap-server.c)
target_sources(app PRIVATE ${iotpatchsrc} src/main.c src/coap/coap-server.c)
# target_sources(app PRIVATE ${iotpatchsrc} src/main.c src/mqtt/mqtt-subscriber.c)
# target_sources(app PRIVATE ${iotpatchsrc} src/main.c)
```

## prj.conf
```kconfig
CONFIG_CONSOLE_SUBSYS=y
CONFIG_CONSOLE_GETCHAR=y
CONFIG_CONSOLE_GETCHAR_BUFSIZE=64
CONFIG_CONSOLE_PUTCHAR_BUFSIZE=512
CONFIG_HEAP_MEM_POOL_SIZE=8192

# CONFIG_STACK_CANARIES=y
CONFIG_NETWORKING=y
CONFIG_NEWLIB_LIBC=y
CONFIG_NET_IPV6=y
CONFIG_NET_UDP=y

CONFIG_NET_SOCKETS=y
CONFIG_NET_SOCKETS_POSIX_NAMES=y
CONFIG_NET_SOCKETS_POLL_MAX=4

CONFIG_COAP=y

CONFIG_HAS_SEGGER_RTT=y
# CONFIG_USE_SEGGER_RTT=y
# CONFIG_RTT_CONSOLE=n
CONFIG_UART_CONSOLE=y

CONFIG_NO_OPTIMIZATIONS=y
```

## nrf52840_usb.conf
```kconfig
# USB MASS
CONFIG_STDOUT_CONSOLE=y
CONFIG_GPIO=y
CONFIG_USB=y
CONFIG_USB_DEVICE_STACK=y
CONFIG_USB_DEVICE_PRODUCT="Zephyr MSC sample"
CONFIG_LOG=y
CONFIG_USB_DRIVER_LOG_LEVEL_ERR=y
CONFIG_USB_MASS_STORAGE=y
CONFIG_USB_DEVICE_LOG_LEVEL_ERR=y
CONFIG_USB_MASS_STORAGE_LOG_LEVEL_ERR=y
CONFIG_DISK_ACCESS_RAM=y
CONFIG_MASS_STORAGE_DISK_NAME="RAM"
```

## overlay-coapperf.conf
```kconfig
# Generic networking options
CONFIG_NETWORKING=y
CONFIG_NEWLIB_LIBC=y
CONFIG_NET_UDP=y

# Socket
CONFIG_NET_SOCKETS=y
CONFIG_NET_SOCKETS_POSIX_NAMES=y
CONFIG_NET_SOCKETS_POLL_MAX=4

# CoAP
CONFIG_COAP=y
CONFIG_COAP_WELL_KNOWN_BLOCK_WISE=y

# Kernel options
CONFIG_ENTROPY_GENERATOR=y
CONFIG_TEST_RANDOM_GENERATOR=y

# Logging
CONFIG_PRINTK=y
CONFIG_NET_LOG=y

# Network Shell
# CONFIG_NET_SHELL=y

CONFIG_MAIN_STACK_SIZE=2048
CONFIG_HEAP_MEM_POOL_SIZE=2048

# Configuration
CONFIG_NET_CONFIG_SETTINGS=y

# Enable only one protocol, if you enable both sources
# won't compile.
# IPv6 Support
CONFIG_NET_IPV6=n
CONFIG_NET_CONFIG_NEED_IPV6=n
CONFIG_NET_CONFIG_MY_IPV6_ADDR="2001:db8::1"
CONFIG_NET_IF_MCAST_IPV6_ADDR_COUNT=5

#IPv4 Support
CONFIG_NET_IPV4=y
CONFIG_NET_CONFIG_NEED_IPV4=y
CONFIG_NET_CONFIG_MY_IPV4_ADDR="192.0.2.3"


###### USB networking ######
# USB Device settings
CONFIG_USB=y
CONFIG_USB_DEVICE_STACK=y

# Select USB Configurations
CONFIG_USB_DEVICE_NETWORK_ECM=y
# CONFIG_USB_DEVICE_NETWORK_RNDIS=y
CONFIG_USB_DEVICE_OS_DESC=y
# CONFIG_HELLO=y
CONFIG_TINYCBOR=n

# Logging
CONFIG_USB_DRIVER_LOG_LEVEL_INF=y
CONFIG_USB_DEVICE_LOG_LEVEL_INF=y
CONFIG_INIT_STACKS=n

# Disable shell built-in commands to reduce ROM footprint
# CONFIG_SHELL_CMDS=y

# RTT
CONFIG_HAS_SEGGER_RTT=y
CONFIG_USE_SEGGER_RTT=y
```

## overlay-mqtt.conf
```kconfig
CONFIG_NETWORKING=y
CONFIG_NET_SOCKETS=y
CONFIG_NET_TCP=y
CONFIG_NET_LOG=n

CONFIG_NET_IPV6_RA_RDNSS=y
CONFIG_NET_IF_UNICAST_IPV6_ADDR_COUNT=3
CONFIG_NET_IF_MCAST_IPV6_ADDR_COUNT=2

CONFIG_PRINTK=n
CONFIG_STDOUT_CONSOLE=y

# Enable IPv6 support
CONFIG_NET_IPV6=n
# Enable IPv4 support
CONFIG_NET_IPV4=y

# Enable the MQTT Lib
CONFIG_MQTT_LIB=y

CONFIG_NET_CONFIG_SETTINGS=y
CONFIG_NET_CONFIG_MY_IPV6_ADDR="2001:db8::1"
CONFIG_NET_CONFIG_PEER_IPV6_ADDR="2001:db8::2"

CONFIG_NET_CONFIG_MY_IPV4_ADDR="192.0.2.3"
CONFIG_NET_CONFIG_PEER_IPV4_ADDR="192.0.2.1"

CONFIG_MAIN_STACK_SIZE=2048

# For IPv6
CONFIG_NET_BUF_DATA_SIZE=256

# CONFIG_NET_SHELL=y



###### USB networking ######
# USB Device settings
CONFIG_USB=y
CONFIG_USB_DEVICE_STACK=y

# Select USB Configurations
CONFIG_USB_DEVICE_NETWORK_ECM=y
# CONFIG_USB_DEVICE_NETWORK_RNDIS=y
CONFIG_USB_DEVICE_OS_DESC=y
# CONFIG_HELLO=y
CONFIG_TINYCBOR=n

# Logging
CONFIG_USB_DRIVER_LOG_LEVEL_INF=y
CONFIG_USB_DEVICE_LOG_LEVEL_INF=y
CONFIG_INIT_STACKS=n

# Disable shell built-in commands to reduce ROM footprint
# CONFIG_SHELL_CMDS=y

# RTT
CONFIG_HAS_SEGGER_RTT=y
CONFIG_USE_SEGGER_RTT=y
```

## overlay-netusb.conf
```kconfig
# USB Device settings
CONFIG_USB=y
CONFIG_USB_DEVICE_STACK=y

# Select USB Configurations
CONFIG_USB_DEVICE_NETWORK_ECM=y
# CONFIG_USB_DEVICE_NETWORK_RNDIS=y
CONFIG_USB_DEVICE_OS_DESC=y
# CONFIG_HELLO=y
CONFIG_TINYCBOR=y

# Logging
CONFIG_USB_DRIVER_LOG_LEVEL_INF=y
CONFIG_USB_DEVICE_LOG_LEVEL_INF=y
CONFIG_INIT_STACKS=n

# Disable shell built-in commands to reduce ROM footprint
# CONFIG_SHELL_CMDS=n

# RTT
# CONFIG_HAS_SEGGER_RTT=y
# CONFIG_USE_SEGGER_RTT=y
# CONFIG_RTT_CONSOLE=y
# CONFIG_UART_CONSOLE=n


###### USB NETWORKING ######
# Generic networking options
CONFIG_NETWORKING=y
CONFIG_NET_UDP=n
CONFIG_NET_TCP=y
CONFIG_NET_IPV6=n
CONFIG_NET_IPV4=y
CONFIG_NET_SOCKETS=y
CONFIG_NET_SOCKETS_POSIX_NAMES=y
CONFIG_NET_SOCKETS_POLL_MAX=4

# Kernel options
CONFIG_MAIN_STACK_SIZE=2048
CONFIG_ENTROPY_GENERATOR=y
CONFIG_TEST_RANDOM_GENERATOR=y
CONFIG_INIT_STACKS=y

# Logging
CONFIG_NET_LOG=y
CONFIG_LOG=y
CONFIG_NET_STATISTICS=y
CONFIG_PRINTK=y

# Network buffers
CONFIG_NET_PKT_RX_COUNT=16
CONFIG_NET_PKT_TX_COUNT=16
CONFIG_NET_BUF_RX_COUNT=80
CONFIG_NET_BUF_TX_COUNT=80
CONFIG_NET_CONTEXT_NET_PKT_POOL=y

# IP address options
# CONFIG_NET_IF_UNICAST_IPV6_ADDR_COUNT=3
# CONFIG_NET_IF_MCAST_IPV6_ADDR_COUNT=4
CONFIG_NET_MAX_CONTEXTS=10

# Network shell
# CONFIG_NET_SHELL=y

# The addresses are selected so that qemu<->qemu connectivity works ok.
# For linux<->qemu connectivity, create a new conf file and swap the
# addresses (so that peer address is ending to 2).
CONFIG_NET_CONFIG_SETTINGS=y
# CONFIG_NET_CONFIG_MY_IPV6_ADDR="2001:db8::2"
# CONFIG_NET_CONFIG_PEER_IPV6_ADDR="2001:db8::1"
CONFIG_NET_CONFIG_MY_IPV4_ADDR="192.0.2.3"
CONFIG_NET_CONFIG_PEER_IPV4_ADDR="192.0.2.1"
```

## overlay-usbmass.conf
```kconfig
CONFIG_STDOUT_CONSOLE=y
CONFIG_GPIO=y

#USB related configs
CONFIG_USB=y
CONFIG_USB_DC_STM32=y
CONFIG_USB_DEVICE_STACK=y
CONFIG_USB_DEVICE_PRODUCT="Zephyr MSC sample"
CONFIG_LOG=y
CONFIG_USB_DRIVER_LOG_LEVEL_ERR=y
CONFIG_USB_MASS_STORAGE=y
CONFIG_USB_DEVICE_LOG_LEVEL_ERR=y
CONFIG_USB_MASS_STORAGE_LOG_LEVEL_ERR=y
CONFIG_STACK_CANARIES=y
CONFIG_ENTROPY_GENERATOR=y
CONFIG_TEST_RANDOM_GENERATOR=y
# If the target's code needs to do file operations, enable target's
# FAT FS code. (Without this only the host can access the fs contents)
#CONFIG_FILE_SYSTEM=y

###### nrf52840 ######
CONFIG_DISK_ACCESS_RAM=y
CONFIG_MASS_STORAGE_DISK_NAME="RAM"

# CONFIG_DISK_ACCESS_FLASH=y
# CONFIG_MASS_STORAGE_DISK_NAME="NAND"
# CONFIG_SPI=y
```

## src/main.c
```c
/*
 * Copyright (c) 2012-2014 Wind River Systems, Inc.
 *
 * SPDX-License-Identifier: Apache-2.0
 */

#include <zephyr.h>
#include <misc/printk.h>
#include <console.h>
#include <stdio.h>
#include <string.h>

#include "include/patch_service.h"
#include "include/iotpatch.h"
#include "libebpf/include/ebpf_allocator.h"
#include "include/utils.h"

#include "hotpatch/include/profiling.h"

#include "app/ihp_cli.h"

#ifdef DEV_COAP
#include "common.h"
#endif

#ifdef DEV_MQTT
#include "config.h"
#endif


K_THREAD_DEFINE(cli_thread, STACK_SIZE,
	run_shell_cli, NULL, NULL, NULL,
	THREAD_PRIORITY, 0, K_FOREVER);

static void load_fixed_patch_0(void);
static void ebpf_test();
extern void arm_core_mpu_disable();
void main(void)
{

	console_init();
	//printk("Hello World! %s\n", CONFIG_BOARD);
	k_thread_start(cli_thread);

	//run_coap_server();
	profile_add_event("micro profile dynamic start");
	profile_add_event("micro profile fixed start");
	profile_add_event("uart print profile start");
	profile_add_event("eBPF exec time evaluation start");

	#ifdef DEV_COAP
	// run_coap_server();
	#endif

	#ifdef DEV_MQTT
	// run_mqtt_subscriber();
	#endif

	#define USE_JIT
	#ifdef USE_JIT
	// disable mpu
	arm_core_mpu_disable();
	// https://lists.zephyrproject.org/g/users/topic/random_fault_exception/30793151?p=
	// CONFIG_NO_OPTIMIZATIONS=y
	#endif

	// ebpf_test();
}

//------------------------------------------------------
// ebpf code evaluation
static uint8_t fixed_patch_0[64] = ""
"\x01\x00\x38\x00\x00\x00\x00\x00\x61\x11\x04\x00\x00\x00\x00\x00\x67\x01\x00\x00\x20\x00\x00\x00\xc7"
"\x01\x00\x00\x20\x00\x00\x00\xb7\x00\x00\x00\x01\x00\x00\x00\x65\x01\x01\x00\x13\x00\x00\x00\xb7\x00"
"\x00\x00\x00\x00\x00\x00\x95\x00\x00\x00\x00\x00\x00\x00"
"";

static uint8_t sign_0[16] = "\x73\x73\x73\x73\x73\x73\x73\x73\x73\x73\x73\x73\x73\x73\x73\x73";

typedef struct stack_frame {
	uint32_t r0;
	uint32_t r1;
	uint32_t r2;
	uint32_t r3;
	uint32_t r12; // ip
	uint32_t lr;
	uint32_t pc; // return address
	uint32_t xpsr;
} stack_frame;

// cve-2020-10063

static uint16_t coap_len = 21;

static uint8_t fixed_patch_10063[128] = ""
"\x01\x00\x78\x00\x00\x00\x00\x00\x61\x11\x04\x00\x00\x00\x00\x00\x07\x01\x00\x00\x05\x00\x00\x00\x67"
"\x01\x00\x00\x20\x00\x00\x00\x77\x01\x00\x00\x20\x00\x00\x00\x69\x12\x00\x00\x00\x00\x00\x00\x18\x01"
"\x00\x00\xea\xff\xff\xff\x00\x00\x00\x00\x00\x00\x00\x00\x25\x02\x01\x00\xff\xef\x00\x00\xb7\x01\x00"
"\x00\x00\x00\x00\x00\xb7\x00\x00\x00\x01\x00\x00\x00\x25\x02\x01\x00\xff\xef\x00\x00\xb7\x00\x00\x00"
"\x00\x00\x00\x00\x67\x00\x00\x00\x20\x00\x00\x00\x4f\x10\x00\x00\x00\x00\x00\x00\x95\x00\x00\x00\x00"
"\x00\x00\x00"
"";

// cve-2020-10021

static uint16_t usb_target = 21;
static uint16_t mem_size = 100;

static uint8_t fixed_patch_10021[96] = ""
"\x01\x00\x58\x00\x00\x00\x00\x00\xb7\x00\x00\x00\x00\x00\x00\x00\x61\x12\x00\x00\x00\x00\x00\x00\x61"
"\x13\x04\x00\x00\x00\x00\x00\x61\x33\x00\x00\x00\x00\x00\x00\x2d\x23\x04\x00\x00\x00\x00\x00\xb7\x03"
"\x00\x00\x7c\x97\x00\x00\x63\x31\x14\x00\x00\x00\x00\x00\x18\x00\x00\x00\x00\x00\x00\x00\x00\x00\x00"
"\x00\x01\x00\x00\x00\x4f\x20\x00\x00\x00\x00\x00\x00\x95\x00\x00\x00\x00\x00\x00\x00"
"";

// cve-2020-10024

static uint8_t fixed_patch_10024[88] = ""
"\x01\x00\x50\x00\x00\x00\x00\x00\xb7\x00\x00\x00\x00\x00\x00\x00\x71\x12\x1f\x00\x00\x00\x00\x00\x57"
"\x02\x00\x00\x20\x00\x00\x00\x15\x02\x05\x00\x00\x00\x00\x00\x61\x12\x18\x00\x00\x00\x00\x00\x07\x02"
"\x00\x00\x04\x00\x00\x00\x63\x21\x14\x00\x00\x00\x00\x00\x18\x00\x00\x00\x00\x00\x00\x00\x00\x00\x00"
"\x00\x01\x00\x00\x00\x95\x00\x00\x00\x00\x00\x00\x00"
"";

// cve-2020-10028

static struct gpio_struct2 {
	int a;
	int b;
	int c;
	int d;
	int *e;
};

static struct gpio_struct1 {
	int a;
	struct gpio_struct2* b;
};

static uint8_t fixed_patch_10028[112] = ""
"\x01\x00\x68\x00\x00\x00\x00\x00\x61\x11\x04\x00\x00\x00\x00\x00\x61\x11\x04\x00\x00\x00\x00\x00\x61"
"\x12\x00\x00\x00\x00\x00\x00\x18\x01\x00\x00\xea\xff\xff\xff\x00\x00\x00\x00\x00\x00\x00\x00\x15\x02"
"\x01\x00\x00\x00\x00\x00\xb7\x01\x00\x00\x00\x00\x00\x00\xb7\x00\x00\x00\x01\x00\x00\x00\x15\x02\x01"
"\x00\x00\x00\x00\x00\xb7\x00\x00\x00\x00\x00\x00\x00\x67\x00\x00\x00\x20\x00\x00\x00\x4f\x10\x00\x00"
"\x00\x00\x00\x00\x95\x00\x00\x00\x00\x00\x00\x00"
"";

// cve-2020-10062

struct mqtt_buf_ctx {
	unsigned char *cur;
    unsigned char *end;
};

static uint8_t fixed_patch_10062[440] = ""
"\x01\x00\xb0\x01\x00\x00\x00\x00\xb7\x03\x00\x00\x01\x00\x00\x00\x61\x11\x00\x00\x00\x00\x00\x00\x79"
"\x12\x00\x00\x00\x00\x00\x00\x71\x21\x00\x00\x00\x00\x00\x00\x67\x01\x00\x00\x38\x00\x00\x00\xc7\x01"
"\x00\x00\x38\x00\x00\x00\x65\x01\x06\x00\xff\xff\xff\xff\xb7\x03\x00\x00\x02\x00\x00\x00\x71\x24\x01"
"\x00\x00\x00\x00\x00\x67\x04\x00\x00\x38\x00\x00\x00\xc7\x04\x00\x00\x38\x00\x00\x00\xb7\x05\x00\x00"
"\x00\x00\x00\x00\x6d\x45\x17\x00\x00\x00\x00\x00\x57\x01\x00\x00\x7f\x00\x00\x00\x55\x03\x04\x00\x01"
"\x00\x00\x00\xb7\x00\x00\x00\xea\xff\xff\xff\x25\x01\x01\x00\xff\xff\xff\x0f\xb7\x00\x00\x00\x00\x00"
"\x00\x00\x95\x00\x00\x00\x00\x00\x00\x00\x71\x24\x01\x00\x00\x00\x00\x00\x57\x04\x00\x00\x7f\x00\x00"
"\x00\x67\x04\x00\x00\x07\x00\x00\x00\x4f\x14\x00\x00\x00\x00\x00\x00\xbf\x41\x00\x00\x00\x00\x00\x00"
"\x15\x03\xf6\xff\x02\x00\x00\x00\x71\x21\x02\x00\x00\x00\x00\x00\x57\x01\x00\x00\x7f\x00\x00\x00\x67"
"\x01\x00\x00\x0e\x00\x00\x00\x4f\x41\x00\x00\x00\x00\x00\x00\x15\x03\xf1\xff\x03\x00\x00\x00\x71\x22"
"\x03\x00\x00\x00\x00\x00\x57\x02\x00\x00\x7f\x00\x00\x00\x67\x02\x00\x00\x15\x00\x00\x00\x4f\x12\x00"
"\x00\x00\x00\x00\x00\xbf\x21\x00\x00\x00\x00\x00\x00\x05\x00\xeb\xff\x00\x00\x00\x00\xb7\x03\x00\x00"
"\x03\x00\x00\x00\x71\x24\x02\x00\x00\x00\x00\x00\x67\x04\x00\x00\x38\x00\x00\x00\xc7\x04\x00\x00\x38"
"\x00\x00\x00\x65\x04\xe4\xff\xff\xff\xff\xff\xb7\x03\x00\x00\x04\x00\x00\x00\x71\x24\x03\x00\x00\x00"
"\x00\x00\x67\x04\x00\x00\x38\x00\x00\x00\xc7\x04\x00\x00\x38\x00\x00\x00\x65\x04\xdf\xff\xff\xff\xff"
"\xff\x18\x00\x00\x00\xea\xff\xff\xff\x00\x00\x00\x00\x00\x00\x00\x00\x71\x24\x04\x00\x00\x00\x00\x00"
"\x67\x04\x00\x00\x38\x00\x00\x00\xc7\x04\x00\x00\x38\x00\x00\x00\xb7\x03\x00\x00\x01\x00\x00\x00\x65"
"\x04\xdd\xff\xff\xff\xff\xff\x05\x00\xd7\xff\x00\x00\x00\x00"
"";

// cve-2018-16524

static struct IPPacket {
	unsigned char padd[24];
	unsigned char *tcpptr;
};

static struct TCPPacket {
	unsigned char data[60];
};

static uint8_t fixed_patch_16524[368] = ""
"\x01\x00\x68\x01\x00\x00\x00\x00\xb7\x00\x00\x00\x00\x00\x00\x00\x61\x11\x04\x00\x00\x00\x00\x00\x71"
"\x11\x18\x00\x00\x00\x00\x00\x71\x12\x2e\x00\x00\x00\x00\x00\xb7\x03\x00\x00\x60\x00\x00\x00\x2d\x23"
"\x26\x00\x00\x00\x00\x00\x77\x02\x00\x00\x02\x00\x00\x00\x57\x02\x00\x00\x3c\x00\x00\x00\x0f\x12\x00"
"\x00\x00\x00\x00\x00\x07\x02\x00\x00\x22\x00\x00\x00\x07\x01\x00\x00\x36\x00\x00\x00\x71\x13\x00\x00"
"\x00\x00\x00\x00\x65\x03\x03\x00\x01\x00\x00\x00\x15\x03\x06\x00\x01\x00\x00\x00\x15\x03\x1d\x00\x00"
"\x00\x00\x00\x05\x00\x02\x00\x00\x00\x00\x00\x15\x03\x0b\x00\x02\x00\x00\x00\x15\x03\x05\x00\x03\x00"
"\x00\x00\x71\x13\x01\x00\x00\x00\x00\x00\x05\x00\x13\x00\x00\x00\x00\x00\x07\x01\x00\x00\x01\x00\x00"
"\x00\x2d\x12\xf5\xff\x00\x00\x00\x00\x05\x00\x15\x00\x00\x00\x00\x00\x71\x13\x01\x00\x00\x00\x00\x00"
"\x55\x03\x0e\x00\x03\x00\x00\x00\x07\x01\x00\x00\x03\x00\x00\x00\x2d\x12\xf0\xff\x00\x00\x00\x00\x05"
"\x00\x10\x00\x00\x00\x00\x00\x71\x13\x01\x00\x00\x00\x00\x00\x55\x03\x09\x00\x04\x00\x00\x00\x71\x12"
"\x03\x00\x00\x00\x00\x00\x71\x11\x02\x00\x00\x00\x00\x00\x67\x01\x00\x00\x08\x00\x00\x00\x4f\x21\x00"
"\x00\x00\x00\x00\x00\x57\x01\x00\x00\xff\xff\x00\x00\xb7\x00\x00\x00\x01\x00\x00\x00\x15\x01\x06\x00"
"\x00\x00\x00\x00\xb7\x00\x00\x00\x00\x00\x00\x00\x05\x00\x04\x00\x00\x00\x00\x00\x0f\x31\x00\x00\x00"
"\x00\x00\x00\x15\x03\x03\x00\x00\x00\x00\x00\x2d\x12\xe1\xff\x00\x00\x00\x00\x05\x00\x01\x00\x00\x00"
"\x00\x00\x67\x00\x00\x00\x20\x00\x00\x00\x95\x00\x00\x00\x00\x00\x00\x00"
"";

// cve-2018-16603

static struct ETHPacket {
	unsigned char padd[28];
	uint64_t xDataLength;
};

static uint8_t fixed_patch_16603[80] = ""
"\x01\x00\x48\x00\x00\x00\x00\x00\x61\x11\x00\x00\x00\x00\x00\x00\x79\x11\x1c\x00\x00\x00\x00\x00\x07"
"\x01\x00\x00\xde\xff\xff\xff\xb7\x00\x00\x00\x01\x00\x00\x00\xb7\x02\x00\x00\x14\x00\x00\x00\x2d\x12"
"\x01\x00\x00\x00\x00\x00\xb7\x00\x00\x00\x00\x00\x00\x00\x67\x00\x00\x00\x20\x00\x00\x00\x95\x00\x00"
"\x00\x00\x00\x00\x00"
"";

// cve-2020-17443

static struct PicoFrame {
	unsigned char padd[38];
	uint16_t transport_len;
};

static uint8_t fixed_patch_17443[112] = ""
"\x01\x00\x68\x00\x00\x00\x00\x00\x61\x11\x00\x00\x00\x00\x00\x00\x69\x12\x26\x00\x00\x00\x00\x00\x18"
"\x01\x00\x00\xff\xff\xff\xff\x00\x00\x00\x00\x00\x00\x00\x00\xb7\x03\x00\x00\x08\x00\x00\x00\x2d\x23"
"\x01\x00\x00\x00\x00\x00\xb7\x01\x00\x00\x00\x00\x00\x00\xb7\x00\x00\x00\x01\x00\x00\x00\x2d\x23\x01"
"\x00\x00\x00\x00\x00\xb7\x00\x00\x00\x00\x00\x00\x00\x67\x00\x00\x00\x20\x00\x00\x00\x4f\x10\x00\x00"
"\x00\x00\x00\x00\x95\x00\x00\x00\x00\x00\x00\x00"
"";

// cve-2020-17445

static uint8_t fixed_patch_17445[288] = ""
"\x01\x00\x18\x01\x00\x00\x00\x00\x61\x12\x00\x00\x00\x00\x00\x00\x61\x13\x08\x00\x00\x00\x00\x00\x07"
"\x03\x00\x00\x02\x00\x00\x00\x71\x21\x01\x00\x00\x00\x00\x00\x07\x02\x00\x00\x02\x00\x00\x00\x67\x01"
"\x00\x00\x03\x00\x00\x00\x47\x01\x00\x00\x06\x00\x00\x00\x18\x00\x00\x00\x00\x00\x00\x00\x00\x00\x00"
"\x00\x01\x00\x00\x00\x18\x04\x00\x00\xff\xff\xff\xff\x00\x00\x00\x00\x00\x00\x00\x00\x71\x25\x01\x00"
"\x00\x00\x00\x00\x07\x05\x00\x00\x02\x00\x00\x00\xbf\x57\x00\x00\x00\x00\x00\x00\x57\x07\x00\x00\xff"
"\x00\x00\x00\x15\x07\x11\x00\x00\x00\x00\x00\xbf\x36\x00\x00\x00\x00\x00\x00\x0f\x76\x00\x00\x00\x00"
"\x00\x00\xbf\x67\x00\x00\x00\x00\x00\x00\x67\x07\x00\x00\x20\x00\x00\x00\x77\x07\x00\x00\x20\x00\x00"
"\x00\x67\x03\x00\x00\x20\x00\x00\x00\x77\x03\x00\x00\x20\x00\x00\x00\x3d\x73\x09\x00\x00\x00\x00\x00"
"\x1f\x51\x00\x00\x00\x00\x00\x00\x57\x05\x00\x00\xff\x00\x00\x00\x0f\x52\x00\x00\x00\x00\x00\x00\xb7"
"\x04\x00\x00\x00\x00\x00\x00\xbf\x15\x00\x00\x00\x00\x00\x00\x57\x05\x00\x00\xff\x00\x00\x00\xbf\x63"
"\x00\x00\x00\x00\x00\x00\xb7\x00\x00\x00\x00\x00\x00\x00\x55\x05\xe6\xff\x00\x00\x00\x00\x4f\x40\x00"
"\x00\x00\x00\x00\x00\x95\x00\x00\x00\x00\x00\x00\x00"
"";


ebpf_patch *get_patch(uint8_t *patch_bytes, int pkt_len) {
	patch_payload paylod;
	paylod.pkt = ebpf_malloc(pkt_len);
	memcpy(paylod.sign, sign_0, 16);
	memcpy(paylod.pkt, patch_bytes, pkt_len);
	patch_desc *patch_d = (patch_desc*) (paylod.pkt);
	ebpf_patch *patch = ebpf_patch_setup(patch_d);
	// DEBUG_LOG("packet size: %d patch type:%d code_len:%d addr:0x%08x\n", pkt_len, patch->type, patch->code_len, patch->inst_addr);
	return patch;
}

void ebpf_test() {
	start_patch_service();
	load_fixed_patch_0();

	// static struct stack_frame sf_10063 = {
	// 	.r0 = 0,
	// 	.r1 = ((uint32_t)(&coap_len)) - 5,
	// 	.r2 = 0,
	// 	.r3 = 0,
	// 	.r12 = 0,
	// 	.lr = 0,
	// 	.pc = 0,
	// 	.xpsr = 0,
	// };

	// eBPF exec time evaluation
	// ebpf_patch *patch = get_patch(fixed_patch_10063, 128);
	// profile_start(3);
	// int ret = run_ebpf_filter(patch, &sf_10063, sizeof(sf_10063));
	// profile_end(3);
	// profile_dump(3);

	// struct stack_frame sf_10021 = {
	// 	.r0 = usb_target,
	// 	.r1 = ((uint32_t)(&mem_size)),
	// 	.r2 = 0,
	// 	.r3 = 0,
	// 	.r12 = 0,
	// 	.lr = 0,
	// 	.pc = 0,
	// 	.xpsr = 0,
	// };

	// ebpf_patch *patch = get_patch(fixed_patch_10021, 96);
	// profile_start(3);
	// int ret = run_ebpf_filter(patch, &sf_10021, sizeof(sf_10021));
	// profile_end(3);
	// profile_dump(3);

	// struct stack_frame sf_10024 = {
	// 	.r0 = 0,
	// 	.r1 = 0,
	// 	.r2 = 0,
	// 	.r3 = 0,
	// 	.r12 = 0,
	// 	.lr = 0,
	// 	.pc = 0,
	// 	.xpsr = 0,
	// };

	// ebpf_patch *patch = get_patch(fixed_patch_10024, 88);
	// profile_start(3);
	// int ret = run_ebpf_filter(patch, &sf_10024, sizeof(sf_10024));
	// profile_end(3);
	// profile_dump(3);

	// struct gpio_struct2 g2 = {
	// 	.a = 0,
	// 	.b = 0,
	// 	.c = 0,
	// 	.d = 0,
	// 	.e = 0,
	// };

	// struct gpio_struct1 g1 = {
	// 	.a = 0,
	// 	.b = &g2,
	// };

	// struct stack_frame sf_10028 = {
	// 	.r0 = 0,
	// 	.r1 = &g1,
	// 	.r2 = 0,
	// 	.r3 = 0,
	// 	.r12 = 0,
	// 	.lr = 0,
	// 	.pc = 0,
	// 	.xpsr = 0,
	// };

	// ebpf_patch *patch = get_patch(fixed_patch_10028, 112);
	// profile_start(3);
	// int ret = run_ebpf_filter(patch, &sf_10028, sizeof(sf_10028));
	// profile_end(3);
	// profile_dump(3);

	// unsigned char mqtt_buf[6] = {0x81, 0x81, 0, 0, 0, 0};
	// struct mqtt_buf_ctx mbc = {
	// 	.cur = mqtt_buf,
	// 	.end = mqtt_buf + 5,
	// };

	// struct stack_frame sf_10062 = {
	// 	.r0 = &mbc,
	// 	.r1 = 0,
	// 	.r2 = 0,
	// 	.r3 = 0,
	// 	.r12 = 0,
	// 	.lr = 0,
	// 	.pc = 0,
	// 	.xpsr = 0,
	// };

	// ebpf_patch *patch = get_patch(fixed_patch_10062, 440);
	// profile_start(3);
	// int ret = run_ebpf_filter(patch, &sf_10062, sizeof(sf_10062));
	// profile_end(3);
	// profile_dump(3);

	// struct TCPPacket tcppkt = {
	// 	.data = {0},
	// };

	// struct IPPacket ippkt = {
	// 	.padd = {0},
	// 	.tcpptr = &tcppkt,
	// };

	// struct stack_frame sf_16524 = {
	// 	.r0 = 0,
	// 	.r1 = &ippkt,
	// 	.r2 = 0,
	// 	.r3 = 0,
	// 	.r12 = 0,
	// 	.lr = 0,
	// 	.pc = 0,
	// 	.xpsr = 0,
	// };

	// ebpf_patch *patch = get_patch(fixed_patch_16524, 368);
	// profile_start(3);
	// int ret = run_ebpf_filter(patch, &sf_16524, sizeof(sf_16524));
	// profile_end(3);
	// profile_dump(3);

	// struct ETHPacket ethpkt = {
	// 	.padd = {0},
	// 	.xDataLength = 100,
	// };

	// struct stack_frame sf_16603 = {
	// 	.r0 = &ethpkt,
	// 	.r1 = 0,
	// 	.r2 = 0,
	// 	.r3 = 0,
	// 	.r12 = 0,
	// 	.lr = 0,
	// 	.pc = 0,
	// 	.xpsr = 0,
	// };

	// ebpf_patch *patch = get_patch(fixed_patch_16603, 80);
	// profile_start(3);
	// int ret = run_ebpf_filter(patch, &sf_16603, sizeof(sf_16603));
	// profile_end(3);
	// profile_dump(3);

	// struct PicoFrame pf = {
	// 	.padd = {0},
	// 	.transport_len = 7,
	// };

	// struct stack_frame sf_17443 = {
	// 	.r0 = &pf,
	// 	.r1 = 0,
	// 	.r2 = 0,
	// 	.r3 = 0,
	// 	.r12 = 0,
	// 	.lr = 0,
	// 	.pc = 0,
	// 	.xpsr = 0,
	// };

	// ebpf_patch *patch = get_patch(fixed_patch_17443, 112);
	// profile_start(3);
	// int ret = run_ebpf_filter(patch, &sf_17443, sizeof(sf_17443));
	// profile_end(3);
	// profile_dump(3);

	uint32_t opt_ptr = 0;
	uint8_t destopt[50] = {1};

	struct stack_frame sf_17445 = {
		.r0 = destopt,
		.r1 = 0,
		.r2 = opt_ptr,
		.r3 = 0,
		.r12 = 0,
		.lr = 0,
		.pc = 0,
		.xpsr = 0,
	};

	ebpf_patch *patch = get_patch(fixed_patch_17445, 288);
	profile_start(3);
	int ret = run_ebpf_filter(patch, &sf_17445, sizeof(sf_17445));
	profile_end(3);
	profile_dump(3);
}

static void load_fixed_patch_0(void) {
	patch_payload paylod;
	int pkt_len = 64;
	paylod.pkt = ebpf_malloc(pkt_len);
	memcpy(paylod.sign, sign_0, 16);
	memcpy(paylod.pkt, fixed_patch_0, pkt_len);
	patch_desc *patch = (patch_desc*) (paylod.pkt);
	DEBUG_LOG("packet size: %d patch type:%d code_len:%d addr:0x%08x\n", pkt_len, patch->type, patch->code_len, patch->inst_addr);
	notify_new_patch(patch);
}
```

## src/common.h
```c
/*
 * Copyright (c) 2017 Intel Corporation.
 * Copyright (c) 2018 Nordic Semiconductor ASA.
 *
 * SPDX-License-Identifier: Apache-2.0
 */

/* Value of 0 will cause the IP stack to select next free port */
#define MY_PORT 0

#define STACK_SIZE 1024

#define PEER_PORT 4242

#define THREAD_PRIORITY K_PRIO_COOP(8)
#define INVALID_SOCK (-1)

struct data {
	const char *proto;

	struct {
		int sock;
		/* Work controlling udp data sending */
		struct k_delayed_work recv;
		struct k_delayed_work transmit;
		u32_t expecting;
		u32_t counter;
	} udp;

	struct {
		int sock;
		u32_t expecting;
		u32_t received;
		u32_t counter;
	} tcp;
};

struct configs {
	struct data ipv4;
	struct data ipv6;
};

#if !defined(CONFIG_NET_CONFIG_PEER_IPV4_ADDR)
#define CONFIG_NET_CONFIG_PEER_IPV4_ADDR ""
#endif

#if !defined(CONFIG_NET_CONFIG_PEER_IPV6_ADDR)
#define CONFIG_NET_CONFIG_PEER_IPV6_ADDR ""
#endif

extern const char lorem_ipsum[];
extern const int ipsum_len;
extern struct configs conf;

int start_udp(void);
int process_udp(void);
void stop_udp(void);

int start_tcp(void);
int process_tcp(void);
void stop_tcp(void);

#if defined(CONFIG_NET_VLAN)
int init_vlan(void);
#else
static inline int init_vlan(void)
{
	return 0;
}
#endif
```

## src/main_empty.c
```c
void __debug_monitor() {
    
}

int main(void) {
    return 0;
}
```
